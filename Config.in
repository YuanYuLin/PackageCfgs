## Config.in
```kconfig
menu "extra packages"

source "package/extra/omxplayer/Config.in"
source "package/extra/ffmpeg2/Config.in"

endmenu
```

## iopccfg/Config.in
```kconfig
config BR2_PACKAGE_IOPCCFG
	bool "iopccfg"
	select BR2_PACKAGE_LIBIOPCCFG
	help
	  IOPC configuration util.
```

## libiopccfg/Config.in
```kconfig
config BR2_PACKAGE_LIBIOPCCFG
	bool "libiopccfg"
	help
	  library of IOPC configuration util.
```
